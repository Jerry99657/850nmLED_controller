## components/kk_oled/Kconfig
```kconfig
menu "KK_OLED: ST7735S 0.96\" 80x160 TFT"

    config TFT_SPI_CLOCK_MHZ
        int "SPI clock (MHz)"
        range 1 40
        default 20

    config TFT_ROTATE_180
        bool "Rotate 180 degrees"
        default y
        help
            横屏方向：关闭时 OLED_SetRotation(90)，打开时 OLED_SetRotation(270)。
            默认按当前板子的屏幕安装方向打开；画面上下颠倒时切换。

    config TFT_INVERT
        bool "Invert colors (INVON)"
        default y
        help
            多数 0.96 英寸 IPS 屏需要开启；底色发白、颜色反相时关闭。

    config TFT_BGR
        bool "BGR color order"
        default y

    config TFT_COL_OFFSET
        int "Column offset (portrait)"
        range 0 60
        default 26
        help
            竖屏方向下可视区第 0 列在控制器 RAM 中的列地址。
            132x162 RAM 的面板常见 26，128x160 RAM 的面板常见 24。

    config TFT_ROW_OFFSET
        int "Row offset (portrait)"
        range 0 60
        default 1
        help
            竖屏方向下可视区第 0 行在控制器 RAM 中的行地址。
            132x162 RAM 的面板常见 1，128x160 RAM 的面板常见 0。

    config TFT_FG_COLOR
        hex "Foreground color (RGB565)"
        range 0x0 0xFFFF
        default 0xFFFF

    config TFT_BG_COLOR
        hex "Background color (RGB565)"
        range 0x0 0xFFFF
        default 0x0000

endmenu
```

## main/Kconfig.projbuild
```kconfig
menu "850nm LED Controller"

    menu "Display / UI"

        config UI_ENABLE
            bool "Initialize the TFT and run the menu UI"
            default y
            help
                关掉后不初始化屏幕、不跑 KK_UI：上电不再画 1.5 s 测试图，按键菜单也没有，
                板子只靠 Wi-Fi / 蓝牙遥控工作（热保护、状态灯、OTA 照常）。
                屏幕装着但初始化失败时，固件也会自动走这条无屏路径，不影响其它功能。
                读取 NVS 设置（温度阈值、软启动、状态灯亮度）与屏幕无关，两种情况都会做。

    endmenu

    menu "LED_PWM"

        config LED_PWM_FREQ_HZ
            int "LED_PWM frequency (Hz)"
            range 1000 5000
            default 2000
            help
                公共 LED_PWM 频率。设计报告建议外部 PWM 1~5 kHz。

        config LED_PWM_SOFTSTART_MS
            int "Soft-start time 0 -> limit (ms)"
            range 100 2000
            default 400
            help
                默认软启动时间，可在界面“设置”中修改。设计报告建议 300~500 ms。

        config LED_PWM_DEMO
            bool "Run PWM step demo at boot"
            default n
            help
                启动后自动循环 5% -> 10% -> 上限 -> 0%，按键调光失效。
                接功率输入时会自动点亮红外阵列，仅在明确需要时打开。

    endmenu

    menu "VBUS detection"

        config VBUS_DIVIDER_PERMILLE
            int "Divider ratio ADC/VBUS (x1000)"
            range 100 1000
            default 332
            help
                ADC0 引脚电压 / VBUS 电压 x 1000。

        config VBUS_9V_THRESHOLD_MV
            int "9V threshold (VBUS mV)"
            range 5500 8500
            default 7000
            help
                VBUS 高于 阈值 + 回差 判为 9 V，低于 阈值 - 回差 判为 5 V。
                默认 7.0 V 对应 ADC 端约 2.32 V，仍在 12 dB 衰减的校准量程内；
                9 V 时 ADC 端约 3.0 V 会饱和，但不影响判档。

        config VBUS_HYSTERESIS_MV
            int "Hysteresis (VBUS mV)"
            range 0 1500
            default 500

        config LED_PWM_LIMIT_5V_PERCENT
            int "Max duty at 5V (%)"
            range 0 100
            default 100
            help
                5 V 输入（含未接功率口、ADC 故障）时的占空比上限。
                默认 100%：不做降额，5 V 下也允许满占空比。
                改回 50 可恢复原来的 5 V 限功率（设计报告里的 P1 风险对策，
                5 V/2 A 电源满占空比可能触发过流保护或欠压复位）。

        config LED_PWM_LIMIT_9V_PERCENT
            int "Max duty at 9V (%)"
            range 0 100
            default 100

        config LP8556_LED_EN
            hex "LP8556 LED_EN (reg 16h)"
            range 0x01 0x3F
            default 0x1F
            help
                bit5:0 对应 LED6:1。默认 0x1F：只开 LED1~5，关闭悬空的 LED6。
                芯片上电默认 0x3F（6 路全开）。每次 VBUS 上电后、PWM 为低时写入。

    endmenu

    menu "Thermal protection"

        # 三个阈值必须保持 恢复 < 预警 < 关断。运行时在板上设置页改的时候，
        # 三者的可调范围是联动的（ui_app.c 的 cfg_update_ranges()），顺序按不坏。
        # 这里只是上电默认值，range 用绝对上下限。改 range 时记得同步
        # main/control.h 里的 CONTROL_*_C_MIN/MAX。

        config THERMAL_WARN_C
            int "Warning threshold (C)"
            range 2 99
            default 55
            help
                状态灯转橙色、状态页显示“温度预警”的温度。只做提示，不影响输出。
                它同时决定关断阈值的下限（= 预警 + 1）。

        config THERMAL_SHUTDOWN_C
            int "Shutdown threshold (C)"
            range 3 100
            default 70
            help
                达到该温度立即关断 LED_PWM 并锁存过温故障。
                设置页里的下限跟着预警阈值走（预警 + 1）。

        config THERMAL_RESUME_C
            int "Resume threshold (C)"
            range 0 90
            default 50
            help
                过温关断后温度降到该值以下，自动按关断前的设定值恢复输出（走软启动斜坡），
                定时关断的剩余时间接着走。设置页里的上限跟着预警阈值走（预警 - 1），
                离关断阈值太近会来回打摆。温度传感器故障、LED 驱动故障仍是锁定式，不受该项影响。

    endmenu

    menu "Wi-Fi remote (phone)"

        config REMOTE_ENABLE
            bool "Enable Wi-Fi hotspot + web control"
            default y
            help
                开启后板子作为热点，手机连接后访问 http://192.168.4.1 控制占空比和定时。
                只有 WPA2 密码一层保护，HTTP 无认证，请修改默认密码。

        config REMOTE_WIFI_SSID_PREFIX
            string "SSID prefix (MAC suffix appended)"
            depends on REMOTE_ENABLE
            default "850nm-"
            help
                实际 SSID = 前缀 + MAC 后 4 位十六进制，例如 850nm-23A0。只用 ASCII 字符。

        config REMOTE_WIFI_PASSWORD
            string "Password (WPA2, 8~63 chars)"
            depends on REMOTE_ENABLE
            default "850nm1234"
            help
                显示在板子“关于”页。只用 ASCII 字符，至少 8 位。

        config REMOTE_WIFI_CHANNEL
            int "Channel"
            depends on REMOTE_ENABLE
            range 1 13
            default 6

        config REMOTE_START_DELAY_MS
            int "Start delay after boot (ms)"
            depends on REMOTE_ENABLE
            range 0 30000
            default 3000
            help
                上电后先完成屏幕、传感器等小电流外设，再延时启动 Wi-Fi，
                避免射频校准和发射的电流尖峰叠加在上电过程中引起欠压复位。
                上次复位原因为欠压时自动延长为 3 倍。

        config REMOTE_WIFI_TX_POWER_DBM
            int "Max TX power (dBm)"
            depends on REMOTE_ENABLE
            range 2 20
            default 10
            help
                降低发射功率可显著降低发射时的峰值电流；10 dBm 在桌面几米内足够。
                另由 CONFIG_ESP_PHY_MAX_WIFI_TX_POWER 限制射频初始化阶段的最大功率。

        config REMOTE_BLE_ENABLE
            bool "Also enable Bluetooth LE control"
            depends on REMOTE_ENABLE && BT_NIMBLE_ENABLED
            default y
            help
                与热点同时广播，广播名与热点 SSID 相同。手机用 Chrome 打开 tools/ble_control.html 连接。
                蓝牙连接后自动关闭热点，断开 3 s 后恢复；有手机连在热点上时停止蓝牙广播。
                未加密，附近任何人都能连接并控制红外输出。

        config REMOTE_WIFI_MAX_CONN
            int "Max phones"
            depends on REMOTE_ENABLE
            range 1 4
            default 2

    endmenu

    config WS2812_BRIGHTNESS_PERCENT
        int "WS2812 default brightness (%)"
        range 5 100
        default 15
        help
            默认状态灯亮度，可在界面“设置”中以 5% 步进修改。

endmenu
```
